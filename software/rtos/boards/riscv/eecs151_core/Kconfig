## software/rtos/boards/riscv/eecs151_core/Kconfig.board
```kconfig
config BOARD_EECS151_CORE
    bool "EECS151 RISC-V Softcore"
    # Change this to match the 'soc' field in your board.yaml
    depends on SOC_SERIES_RISCV_VIRT
    select RISCV
    select RISCV_ISA_EXT_M
    select ATOMIC_OPERATIONS_C
```

## software/rtos/boards/riscv/eecs151_core/eecs151_core_defconfig
```kconfig
# Use Generic RISC-V instead of SiFive to avoid forced PLIC
CONFIG_SOC_SERIES_RISCV_VIRT=y
CONFIG_SOC_RISCV_VIRT=y
CONFIG_BOARD_EECS151_CORE=y

# Core Features
CONFIG_SERIAL=y
CONFIG_CONSOLE=y
CONFIG_UART_CONSOLE=y
CONFIG_UART_NS16550=y
CONFIG_RISCV_MACHINE_TIMER=y
CONFIG_SYS_CLOCK_HW_CYCLES_PER_SEC=100000000

# random stuff getting set to y
CONFIG_UART_ESP32=n
CONFIG_SOC_ESP32C3=n
CONFIG_IDF_TARGET_ESP32C3=n
CONFIG_UART_ROM_ESP32C3=n
CONFIG_ESP32C3_SYS_TIMER=n

# Disable features your RV32I core doesn't have
CONFIG_PLIC=n
CONFIG_RISCV_HAS_PLIC=n
CONFIG_RISCV_PMP=n
CONFIG_FPU=n
CONFIG_XIP=n

# CONFIG_MINIMAL_LIBC=y

# This ensures the RISC-V reset vector is placed at that address
CONFIG_ROM_START_OFFSET=0x0

CONFIG_SRAM_BASE_ADDRESS=0x10000000
CONFIG_SRAM_SIZE=128

# shell
CONFIG_SHELL=y
CONFIG_SHELL_BACKEND_SERIAL=y

CONFIG_UART_INTERRUPT_DRIVEN=n
CONFIG_SHELL_BACKEND_SERIAL_INTERRUPT_DRIVEN=n

CONFIG_CBPRINTF_NANO=n
CONFIG_SHELL_STATS=n

CONFIG_UART_LINE_CTRL=n
CONFIG_TICKLESS_KERNEL=n

# coremark setup

CONFIG_TIMING_FUNCTIONS=y

CONFIG_MAIN_STACK_SIZE=16384
```
