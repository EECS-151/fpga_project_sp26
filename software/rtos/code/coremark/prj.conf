## CMakeLists.txt
```
# SPDX-License-Identifier: Apache-2.0

cmake_minimum_required(VERSION 3.20.0)

# BOARD_ROOT: use env if set (e.g. from software/rtos/conf), else default to repo root (../.. from code/hello_world)
if(DEFINED ENV{BOARD_ROOT})
  list(APPEND BOARD_ROOT $ENV{BOARD_ROOT})
else()
  get_filename_component(RTOS_BOARD_ROOT "${CMAKE_CURRENT_SOURCE_DIR}/../.." ABSOLUTE)
  list(APPEND BOARD_ROOT ${RTOS_BOARD_ROOT})
endif()

# This must come BEFORE find_package(Zephyr)
set(SUBSTITUTE_ARCH_FLAGS "-march=rv32im -mabi=ilp32")
set(ARCH_FLAGS "-march=rv32im -mabi=ilp32")

# Force the toolchain to see the M extension
set(CMAKE_C_FLAGS "-march=rv32im -mabi=ilp32" CACHE INTERNAL "")
set(CMAKE_ASM_FLAGS "-march=rv32im -mabi=ilp32" CACHE INTERNAL "")

find_package(Zephyr REQUIRED HINTS $ENV{ZEPHYR_BASE})
project(hello_world)

set(COREMARK_DIR ${ZEPHYR_BASE}/../modules/benchmark/coremark)
zephyr_include_directories(${COREMARK_DIR})
zephyr_include_directories(${ZEPHYR_BASE}/../code/coremark/src/coremark)

target_sources(app PRIVATE 
    ${COREMARK_DIR}/core_main.c 
    ${COREMARK_DIR}/core_matrix.c 
    ${COREMARK_DIR}/core_list_join.c 
    ${COREMARK_DIR}/core_state.c 
    ${COREMARK_DIR}/core_util.c
    ${ZEPHYR_BASE}/../code/coremark/src/coremark/core_portme.c
)

target_sources(app PRIVATE src/main.c)
```

## prj.conf
```kconfig
CONFIG_COREMARK=y
```

## src/main.c
```c
/*
 * Copyright (c) 2012-2014 Wind River Systems, Inc.
 *
 * SPDX-License-Identifier: Apache-2.0
 */

#include <zephyr.h>
#include <sys/printk.h>

#include <shell/shell.h>

extern int coremark_main(int argc, char *argv[]);

static int cmd_run_coremark(const struct shell *shell, size_t argc, char **argv)
{
    shell_print(shell, "Starting CoreMark");
    return coremark_main(argc, argv);
}

SHELL_CMD_REGISTER(coremark, NULL, "Run CoreMark benchmark", cmd_run_coremark);

void main(void)
{
	printk("Hello World! %s\n", CONFIG_BOARD);
}
```
